## hw/xtensa/Kconfig
```kconfig
config XTENSA_SIM
    default y
    depends on XTENSA
    bool

config XTENSA_VIRT
    bool
    default y
    depends on XTENSA
    select XTENSA_SIM
    select PCI_EXPRESS_GENERIC_BRIDGE
    select PCI_DEVICES

config XTENSA_XTFPGA
    bool
    default y
    depends on XTENSA && FDT
    select DEVICE_TREE
    select OPENCORES_ETH
    select PFLASH_CFI01
    select SERIAL_MM

config MIMXRT685_HIFI4
    bool
    default y
    depends on XTENSA
    select XTENSA_SIM
    select RT6XX_FLEXCOMM
    select RT6XX_GPIO
    select RT6XX_RSTCTL
    select RT6XX_SYSCON
```
